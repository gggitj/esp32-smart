## esp/ESP32_Env_Module_Firmware_20261018/source/esp/S3_Pi_Module/main/Kconfig.projbuild
```kconfig
menu "Pi module data service"

    config APP_PI_DATA_ENABLE
        bool "Enable Orange Pi WiFi/TCP/BLE data service"
        default y

    config APP_PI_DATA_SSID
        string "WiFi SSID to join as STA"
        default "PI_MODULE_NET"

    config APP_PI_DATA_PASSWORD
        string "WiFi password"
        default ""

    config APP_PI_DATA_INSTANCE
        string "module_instance reported in JSON sessions"
        default "pogo-device-test"

    config APP_PI_DATA_TOKEN
        string "session token required by session_open"
        default ""
        help
            Provision a device token in a private sdkconfig. No test credentials
            are supplied by the repository.

    config APP_PI_DATA_PORT
        int "TCP server port"
        default 4580

    config APP_PI_DATA_STATIC_IP
        string "Optional static IPv4 address for the Pi hotspot"
        default ""

    config APP_PI_DATA_NETMASK
        string "Static IPv4 netmask"
        default ""

    config APP_PI_DATA_GATEWAY
        string "Static IPv4 gateway"
        default ""

    config APP_PI_DATA_BLE_NAME
        string "BLE GAP device name"
        default "POGO_DEVICE_TEST"

    choice APP_PI_TRANSPORT_MODE
        prompt "Transport mode announced to the host during LinkIt handshake"
        default APP_PI_TRANSPORT_LAN

        config APP_PI_TRANSPORT_BLE
            bool "BLE-only business data"

        config APP_PI_TRANSPORT_LAN
            bool "LAN-only business data"
    endchoice

    choice APP_PI_PACKAGE_TRANSPORT
        prompt "Signed plugin package path announced to the host"
        default APP_PI_PACKAGE_DATA

        config APP_PI_PACKAGE_DATA
            bool "Use the selected business data lane"

        config APP_PI_PACKAGE_HOTSPOT_HTTP
            bool "BLE business data, hotspot HTTP package"
            depends on APP_PI_TRANSPORT_BLE
    endchoice

endmenu
```

## esp/ESP32_Env_Module_Firmware_20261018/source/esp/S3_Pi_Module/sdkconfig.defaults
```kconfig
CONFIG_IDF_TARGET="esp32s3"
CONFIG_ESPTOOLPY_FLASHSIZE_16MB=y
CONFIG_PARTITION_TABLE_SINGLE_APP_LARGE=y
CONFIG_ESP_MAIN_TASK_STACK_SIZE=8192
CONFIG_BT_ENABLED=y
CONFIG_BT_NIMBLE_ENABLED=y
CONFIG_BT_BLUEDROID_ENABLED=n
CONFIG_BT_NIMBLE_ROLE_PERIPHERAL=y
CONFIG_APP_PI_DATA_ENABLE=y
```

## esp/S3_PiBridge_LinkIt_Host/main/Kconfig.projbuild
```kconfig
menu "S3 Pi control bridge identity"
config PBRIDGE_MODULE_ID
    int "Provisioned product module ID"
    range 1 255
    default 80
config PBRIDGE_INSTANCE
    string "Provisioned module instance (letters, digits, underscore or hyphen)"
    default "pogo-device-test"
endmenu

menu "Bridge RC522 reader"
config BRIDGE_RFID_ENABLED
    bool "Enable RC522 ISO14443A UID reader"
    default y
config BRIDGE_RFID_SS_GPIO
    int "RC522 SDA/SS GPIO (SPI chip select)"
    default 10
config BRIDGE_RFID_SCK_GPIO
    int "RC522 SCK GPIO"
    default 12
config BRIDGE_RFID_MOSI_GPIO
    int "RC522 MOSI GPIO"
    default 11
config BRIDGE_RFID_MISO_GPIO
    int "RC522 MISO GPIO"
    default 13
config BRIDGE_RFID_RST_GPIO
    int "RC522 RST GPIO"
    default 14
config BRIDGE_RFID_READER_ID
    string "Reader ID in RFID events"
    default "front-reader"
config BRIDGE_RFID_POLL_MS
    int "Delay between card polls (ms)"
    range 50 1000
    default 100
config BRIDGE_RFID_REMOVAL_MS
    int "Continuous no-card time before rearming (ms)"
    range 200 5000
    default 400
endmenu
```

## esp/S3_Pi_Module/sdkconfig.defaults
```kconfig
CONFIG_IDF_TARGET="esp32s3"
CONFIG_ESPTOOLPY_FLASHSIZE_16MB=y
CONFIG_PARTITION_TABLE_CUSTOM=y
CONFIG_PARTITION_TABLE_CUSTOM_FILENAME="partitions.csv"
CONFIG_PARTITION_TABLE_FILENAME="partitions.csv"
CONFIG_ESP_MAIN_TASK_STACK_SIZE=8192
CONFIG_BT_ENABLED=y
CONFIG_BT_NIMBLE_ENABLED=y
CONFIG_BT_BLUEDROID_ENABLED=n
CONFIG_BT_NIMBLE_ROLE_PERIPHERAL=y
CONFIG_APP_PI_DATA_ENABLE=y
CONFIG_APP_PI_TRANSPORT_LAN=y
CONFIG_APP_PI_PACKAGE_DATA=y
CONFIG_PLANTER_EXTERNAL_POWER_GPIO=-1
# CONFIG_PLANTER_BATTERY_ONLY_CONFIRMED is not set
CONFIG_LV_COLOR_DEPTH_16=y
CONFIG_LV_FONT_MONTSERRAT_14=y
CONFIG_LV_FONT_MONTSERRAT_24=y
CONFIG_LV_FONT_MONTSERRAT_32=y
```

## module-devkit/examples/smart-planter/firmware/main/Kconfig.projbuild
```kconfig
menu "Pi module data service"

    config APP_PI_DATA_ENABLE
        bool "Enable Orange Pi WiFi/TCP/BLE data service"
        default y

    config APP_PI_DATA_SSID
        string "WiFi SSID to join as STA"
        default "PI_MODULE_NET"

    config APP_PI_DATA_PASSWORD
        string "WiFi password"
        default ""

    config APP_PI_DATA_INSTANCE
        string "module_instance reported in JSON sessions"
        default "pogo-device-test"

    config APP_PI_DATA_TOKEN
        string "session token required by session_open"
        default ""
        help
            Provision a device token in a private sdkconfig. No test credentials
            are supplied by the repository.

    config APP_PI_DATA_PORT
        int "TCP server port"
        default 4580

    config APP_PI_DATA_STATIC_IP
        string "Optional static IPv4 address for the Pi hotspot"
        default ""

    config APP_PI_DATA_NETMASK
        string "Static IPv4 netmask"
        default ""

    config APP_PI_DATA_GATEWAY
        string "Static IPv4 gateway"
        default ""

    config APP_PI_DATA_BLE_NAME
        string "BLE GAP device name"
        default "POGO_DEVICE_TEST"

    choice APP_PI_TRANSPORT_MODE
        prompt "Transport mode announced to the host during LinkIt handshake"
        default APP_PI_TRANSPORT_LAN

        config APP_PI_TRANSPORT_BLE
            bool "BLE-only business data"

        config APP_PI_TRANSPORT_LAN
            bool "LAN-only business data"
    endchoice

    choice APP_PI_PACKAGE_TRANSPORT
        prompt "Signed plugin package path announced to the host"
        default APP_PI_PACKAGE_DATA

        config APP_PI_PACKAGE_DATA
            bool "Use the selected business data lane"

        config APP_PI_PACKAGE_HOTSPOT_HTTP
            bool "BLE business data, hotspot HTTP package"
            depends on APP_PI_TRANSPORT_BLE
    endchoice

endmenu

menu "Planter power detection"
    config PLANTER_EXTERNAL_POWER_GPIO
        int "External supply valid signal GPIO (-1 = not wired)"
        range -1 48
        default -1
        help
            Requires a verified 3.3V-safe PG/VBUS detection circuit.
            Do not use an occupied board pin or connect USB 5V directly.
    config PLANTER_EXTERNAL_POWER_HIGH
        bool "External supply valid signal is active high"
        default y
    config PLANTER_BATTERY_ONLY_CONFIRMED
        bool "Explicitly commissioned battery-only board (no other supply path)"
        default n
        help
            Enable only after verifying the board has no USB or external supply
            bypass. Not a runtime automatic power-source detector.
endmenu
```

## module-devkit/template/firmware/main/Kconfig.projbuild
```kconfig
menu "Module SDK"
choice MODULE_TRANSPORT
    prompt "Module business transport"
    default MODULE_TRANSPORT_BLE
config MODULE_TRANSPORT_BLE
    bool "BLE"
config MODULE_TRANSPORT_LAN
    bool "Hotspot LAN"
endchoice
config MODULE_INSTANCE
    string "Module instance"
    default "module-@MODULE_ID@"
config MODULE_TOKEN
    string "Provisioned module token"
    default ""
    help
        Set privately. Do not commit credentials.
config MODULE_PORT
    int "Business TCP port"
    default 4580
config MODULE_BLE_NAME
    string "BLE device name"
    default "PiModule-@MODULE_ID@"
if MODULE_TRANSPORT_LAN
config PI_HOTSPOT_SSID
    string "Fixed Pi hotspot SSID"
    default "PI_MODULE_NET"
config PI_HOTSPOT_PASSWORD
    string "Fixed Pi hotspot password"
config PI_MODULE_STATIC_IP
    string "Module static IPv4 (empty for DHCP)"
    default ""
config PI_MODULE_NETMASK
    string "Module netmask"
    default ""
config PI_HOTSPOT_GATEWAY
    string "Fixed Pi hotspot IPv4 gateway"
    default ""
endif
endmenu
```
